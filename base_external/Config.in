## base_external/Config.in
```kconfig
source "$BR2_EXTERNAL_rpi5overlay_PATH/package/rpi4KernelDriver/Config.in"
source "$BR2_EXTERNAL_rpi5overlay_PATH/package/rpi4UserSpaceApp/Config.in"
```

## base_external/package/rpi4KernelDriver/Config.in
```kconfig
config BR2_PACKAGE_RPI4KERNELDRIVER
	bool "rpi4kerneldriver"
	help
        The user space application for the rpi4 final project
```

## base_external/package/rpi4UserSpaceApp/Config.in
```kconfig
config BR2_PACKAGE_RPI4USERSPACEAPP
	bool "rpi4userspaceapp"
	help
        The user space application for the rpi4 final project
```
